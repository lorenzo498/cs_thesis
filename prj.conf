## prj.conf
```kconfig
#
# Copyright (c) 2020 Nordic Semiconductor
#
# SPDX-License-Identifier: LicenseRef-Nordic-5-Clause
#
#CONFIG_NRF_SW_LPUART=y

# Sample is showing low power capabilities of low power uart module thus
# console/logging uart is disabled.
# Uncomment this section for debugging. Additionally, comment uart0 disabling
# in overlay.

CONFIG_USE_SEGGER_RTT=n
CONFIG_LOG=y
CONFIG_NO_OPTIMIZATIONS=y
CONFIG_ASSERT=y

# Comment this section for debugging
#CONFIG_CONSOLE=n
#CONFIG_UART_CONSOLE=n

# Uncomment to use lpuart using interrupt driven API
CONFIG_NRF_SW_LPUART_INT_DRIVEN=y
```

## boards/nrf9160dk_nrf9160ns.conf
```kconfig
#
# Copyright (c) 2020 Nordic Semiconductor
#
# SPDX-License-Identifier: LicenseRef-Nordic-5-Clause
#
CONFIG_UART_ASYNC_API=y
CONFIG_UART_1_ASYNC=y
CONFIG_UART_1_INTERRUPT_DRIVEN=n
CONFIG_UART_1_NRF_HW_ASYNC=y
CONFIG_UART_1_NRF_HW_ASYNC_TIMER=2
CONFIG_NRFX_TIMER2=y
CONFIG_RESET_ON_FATAL_ERROR=n
```

## boards/nrf9160dk_nrf9160.overlay
```dts
/* SPDX-License-Identifier: LicenseRef-Nordic-5-Clause */

&uart1 {
	rx-pin = <10>;
	tx-pin = <11>;
	current-speed = <115200>;
	/delete-property/ rts-pin;
	/delete-property/ cts-pin;
	//rts-pin = < 12 >;
	//cts-pin = < 13 >;

	/*lpuart: nrf-sw-lpuart {
		compatible = "nordic,nrf-sw-lpuart";
		status = "okay";
		label = "LPUART";
		req-pin = <12>;
		rdy-pin = <13>;
	};*/
};

&uart0 {
	//status = "disabled";
};

&gpiote {
	interrupts = <13 NRF_DEFAULT_IRQ_PRIORITY>;
};
```

## boards/nrf9160dk_nrf9160ns.overlay
```dts
/* SPDX-License-Identifier: LicenseRef-Nordic-5-Clause */

&uart1 {
	rx-pin = <10>;
	tx-pin = <11>;
	status = "okay";
	/delete-property/ rts-pin;
	/delete-property/ cts-pin;
	/*/delete-property/ rts-pin;
	/delete-property/ cts-pin;*/
	//rts-pin = < 12 >;
	//cts-pin = < 13 >;

	/*lpuart: nrf-sw-lpuart {
		compatible = "nordic,nrf-sw-lpuart";
		status = "okay";
		label = "LPUART";
		req-pin = <12>;
		rdy-pin = <13>;
	};*/
};

&uart0 {
	//status = "disabled";
};

&gpiote {
	interrupts = <13 NRF_DEFAULT_IRQ_PRIORITY>;
};
```

## src/main.c
```c
/*
 * Copyright (c) 2020 Nordic Semiconductor ASA
 *
 * SPDX-License-Identifier: LicenseRef-Nordic-5-Clause
 */

#include <zephyr.h>
#include <logging/log.h>
#include <drivers/uart.h>

LOG_MODULE_REGISTER(app);
//PRIMA ERA 64 BUF SIZE
const char *myQrCode[100];

#define BUF_SIZE 32
static K_MEM_SLAB_DEFINE(uart_slab, BUF_SIZE, 3, 4);

static void uart_irq_handler(const struct device *dev, void *context)
{
	uint8_t buf[] = {1, 2, 3, 4, 5};
	if (uart_irq_tx_ready(dev)) {
		(void)uart_fifo_fill(dev, buf, sizeof(buf));
		uart_irq_tx_disable(dev);
	}

	if (uart_irq_rx_ready(dev)) {
		uint8_t buf[10];
		int len = uart_fifo_read(dev, buf, sizeof(buf));

		if (len) {
			printk("read %d bytes\n", len);
		}
	}
}

static void interrupt_driven(const struct device *dev)
{
	uint8_t c = 0xff;

	uart_irq_callback_set(dev, uart_irq_handler);
	uart_irq_rx_enable(dev);
	while (1) {
		uart_irq_tx_enable(dev);
		k_sleep(K_MSEC(500));

		uart_poll_out(dev, c);
		k_sleep(K_MSEC(100));
	}
}

static void uart_callback(const struct device *dev,
			  struct uart_event *evt,
			  void *user_data)
{
	struct device *uart = user_data;
	int err;

	switch (evt->type) {
	case UART_TX_DONE:

		// LOG_INF("Tx sent %d bytes", evt->data.tx.len);
		break;

	case UART_TX_ABORTED:
		LOG_ERR("Tx aborted");
		break;

	case UART_RX_RDY:
			printk("%s\n", evt->data.rx);

		LOG_INF("Received data %d bytes", evt->data.rx.len);
		break;

	case UART_RX_BUF_REQUEST:
	{
		uint8_t *buf;

		err = k_mem_slab_alloc(&uart_slab, (void **)&buf, K_NO_WAIT);
		__ASSERT(err == 0, "Failed to allocate slab");

		err = uart_rx_buf_rsp(uart, buf, BUF_SIZE);
		__ASSERT(err == 0, "Failed to provide new buffer");
		break;
	}

	case UART_RX_BUF_RELEASED:
		k_mem_slab_free(&uart_slab, (void **)&evt->data.rx_buf.buf);
		break;

	case UART_RX_DISABLED:
		break;

	case UART_RX_STOPPED:
		break;
	}
}

static void async(const struct device *lpuart)
{
	uint8_t txbuf[5] = {1, 2, 3, 4, 5};
	int err;
	uint8_t *buf;

	err = k_mem_slab_alloc(&uart_slab, (void **)&buf, K_NO_WAIT);
	__ASSERT(err == 0, "Failed to alloc slab");

	err = uart_callback_set(lpuart, uart_callback, (void *)lpuart);
	__ASSERT(err == 0, "Failed to set callback");

	err = uart_rx_enable(lpuart, buf, BUF_SIZE, 10);
	__ASSERT(err == 0, "Failed to enable RX");

	while (1) {
		err = uart_tx(lpuart, txbuf, sizeof(txbuf), 10);
		__ASSERT(err == 0, "Failed to initiate transmission");

		k_sleep(K_MSEC(500));

		uart_poll_out(lpuart, txbuf[0]);
		k_sleep(K_MSEC(100));
	}
}

void main(void)
{
	const struct device *lpuart;

	k_msleep(1000);

	lpuart = device_get_binding("UART_1");
	__ASSERT(lpuart, "Failed to get the device");
	if (IS_ENABLED(CONFIG_NRF_SW_LPUART_INT_DRIVEN)) {			
		interrupt_driven(lpuart);
	} else {
		async(lpuart);
	}
}
```
