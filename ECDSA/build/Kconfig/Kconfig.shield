## ECDSA/build/Kconfig/Kconfig.shield
```kconfig
osource "/Users/lorenzobrancaleoni/Progetti/Progetto_ESP/ecdsa/boards/shields/*/Kconfig.shield"
osource "/opt/nordic/ncs/v1.9.1/nrf/boards/shields/*/Kconfig.shield"
```

## ECDSA/build/Kconfig/Kconfig.shield.defconfig
```kconfig
osource "/Users/lorenzobrancaleoni/Progetti/Progetto_ESP/ecdsa/boards/shields/*/Kconfig.defconfig"
osource "/opt/nordic/ncs/v1.9.1/nrf/boards/shields/*/Kconfig.defconfig"
```

## KECCAK256/build/Kconfig/Kconfig.shield
```kconfig
osource "c:/Users/Gioele/Desktop/Tesi/cs_thesis/KECCAK256/boards/shields/*/Kconfig.shield"
osource "C:/ncs/v1.9.0/nrf/boards/shields/*/Kconfig.shield"
```

## KECCAK256/build/Kconfig/Kconfig.shield.defconfig
```kconfig
osource "c:/Users/Gioele/Desktop/Tesi/cs_thesis/KECCAK256/boards/shields/*/Kconfig.defconfig"
osource "C:/ncs/v1.9.0/nrf/boards/shields/*/Kconfig.defconfig"
```

## RLP/build/Kconfig/Kconfig.shield
```kconfig
osource "c:/Users/Gioele/Desktop/Tesi/cs_thesis/RLP/boards/shields/*/Kconfig.shield"
osource "C:/ncs/v1.9.0/nrf/boards/shields/*/Kconfig.shield"
```

## RLP/build/Kconfig/Kconfig.shield.defconfig
```kconfig
osource "c:/Users/Gioele/Desktop/Tesi/cs_thesis/RLP/boards/shields/*/Kconfig.defconfig"
osource "C:/ncs/v1.9.0/nrf/boards/shields/*/Kconfig.defconfig"
```

## RLP_KECCAK256/build/Kconfig/Kconfig.shield.defconfig
```kconfig
osource "/Users/lorenzobrancaleoni/Progetti/Progetto_ESP/nrf9160_device/RLP/boards/shields/*/Kconfig.defconfig"
osource "/opt/nordic/ncs/v1.9.1/nrf/boards/shields/*/Kconfig.defconfig"
```

## build/Kconfig/Kconfig.shield
```kconfig
osource "c:/Users/Gioele/Desktop/Esp/Official/gps/gps/boards/shields/*/Kconfig.shield"
osource "c:/Users/Gioele/Desktop/Esp/Official/ESP_project/boards/shields/*/Kconfig.shield"
osource "C:/ncs/v1.7.1/nrf/boards/shields/*/Kconfig.shield"
```

## build/Kconfig/Kconfig.shield.defconfig
```kconfig
osource "/Users/lorenzobrancaleoni/Progetti/Progetto_ESP/ESP_project/boards/shields/*/Kconfig.defconfig"
osource "/opt/nordic/ncs/v1.7.1/nrf/boards/shields/*/Kconfig.defconfig"
```

## gps_Project/build/Kconfig/Kconfig.shield
```kconfig
osource "c:/Users/Gioele/Desktop/Esp/Official/gps/gps/boards/shields/*/Kconfig.shield"
osource "C:/ncs/v1.7.1/nrf/boards/shields/*/Kconfig.shield"
```

## main_project/build/Kconfig/Kconfig.shield
```kconfig
osource "/Users/lorenzobrancaleoni/Progetti/Progetto_ESP/main_project/boards/shields/*/Kconfig.shield"
osource "/opt/nordic/ncs/v1.9.1/nrf/boards/shields/*/Kconfig.shield"
```
